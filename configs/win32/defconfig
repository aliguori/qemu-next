## configs/win32/defconfig
```kconfig
# CONFIG_BDRV_RAW_POSIX is not set
CONFIG_BDRV_RAW_WIN32=y
CONFIG_BDRV_BOCHS=y
CONFIG_BDRV_CLOOP=y
# CONFIG_BDRV_COW is not set
CONFIG_BDRV_DMG=y
CONFIG_BDRV_NBD=y
CONFIG_BDRV_PARALLELS=y
CONFIG_BDRV_QCOW2=y
CONFIG_BDRV_QCOW=y
CONFIG_BDRV_VMDK=y
CONFIG_BDRV_VPC=y
CONFIG_BDRV_VVFAT=y
```
